## board/freescale/imx8mq_adv/Kconfig
```kconfig
if TARGET_IMX8MQ_ADV

config SYS_BOARD
	default "imx8mq_adv"

config SYS_VENDOR
	default "freescale"

config SYS_CONFIG_NAME
	default "imx8mq_adv"

config IMX_CONFIG
	default "arch/arm/mach-imx/imx8m/imximage.cfg"

source "board/freescale/common/Kconfig"

endif
```
